## conf/distro/include/basecamp-feed.conf
```bitbake
PACKAGE_FEED_URIS = "https://petalinux.xilinx.com/sswreleases/basecamp/rel-${@(d.getVar('XILINX_RELEASE_VERSION') or '').split('.')[0]}/generic/rpm/rpm_latest"
PACKAGE_FEED_URIS:versal-2ve-2vm = "https://petalinux.xilinx.com/sswreleases/basecamp_versal_2ve_2vm/rel-${@(d.getVar('XILINX_RELEASE_VERSION') or '').split('.')[0]}/generic/rpm/rpm_latest"

# Package feed names always use '_', while ARCH names might include -
PACKAGE_FEED_ARCHS ?= "${@d.getVar('PACKAGE_ARCHS').replace('-','_')}"
```

## conf/machine/xlnx-versal-vek280-revb-ospi.conf
```bitbake
#@TYPE: Machine
#@NAME: xlnx-versal-vek280-revb-ospi
#@DESCRIPTION: Machine configuration for the xlnx-versal-vek280-revb-ospi boot.

#### Preamble
MACHINEOVERRIDES =. "${@['', 'xlnx-versal-vek280-revb-opsi:']['xlnx-versal-vek280-revb-ospi' !='${MACHINE}']}"
#### Regular settings follow

# Required xlnx-versal-vek280-revb machine inclusion
require conf/machine/xlnx-versal-vek280-revb.conf

EXTRA_IMAGEDEPENDS:remove = "\
    virtual/boot-bin \
    virtual/psm-firmware \
    virtual/plm \
    virtual/cdo \
    virtual/bootloader \
    arm-trusted-firmware \
    "

WIC_DEPENDS:remove = "\
    virtual/bootloader \
    virtual/boot-bin \
    virtual/arm-trusted-firmware \
    "

MACHINE_ESSENTIAL_EXTRA_RDEPENDS:remove = "xilinx-bootbin u-boot-xlnx-bin"

QB_BOOT_MODE += " -boot mode=8"
QB_OSPI_FILE ?= "${DEPLOY_DIR_IMAGE}/ospi-${MACHINE}.bin"
QB_OPT_APPEND:append := " -drive file=${QB_OSPI_FILE},if=mtd,format=raw,index=4"

#### No additional settings should be after the Postamble
#### Postamble
PACKAGE_EXTRA_ARCHS:append = "${@['', ' xlnx_versal_vek280_revb_ospi']['xlnx-versal-vek280-revb-ospi' != '${MACHINE}']}"
```

## meta-amd-edf-core/conf/layer.conf
```bitbake
# We have a conf and classes directory, add to BBPATH
BBPATH .= ":${LAYERDIR}"

# TO override a oe-core bbclass
BBPATH =. "${LAYERDIR}/oe-core/meta:"

# We have recipes-* directories, add to BBFILES
BBFILES += " \
    ${LAYERDIR}/recipes-*/*/*.bb \
    ${LAYERDIR}/recipes-*/*/*.bbappend \
    "

BBFILE_COLLECTIONS += "amd-edf-core"
BBFILE_PRIORITY_amd-edf-core = "5"

LAYERSUMMARY_amd-edf-core = "AMD Embedded Development Framework reference \
distro"
LAYERDESCRIPTION_amd-edf-core = "Distribution layer providing the amd-edf \
and amd-edf-small distros, image recipes, packagegroups, and SDK \
helpers that make up the AMD Embedded Development Framework reference \
platform."
BBFILE_PATTERN_amd-edf-core = "^${LAYERDIR}/"
BBFILE_PATTERN_IGNORE_EMPTY_amd-edf-core = "1"

LAYERDEPENDS_amd-edf-core = "\
    core \
    yocto \
    openembedded-layer \
    meta-python \
    xilinx \
    xilinx-standalone \
    xilinx-standalone-sdt \
    xilinx-microblaze \
    xilinx-demos \
    meta-xilinx-imgrcry \
    amd-adaptive-socs-core \
    amd-adaptive-socs-bsp \
    ros2-layer \
    ros2-lyrical-layer \
    openamp-layer \
    vitis-ai \
    xilinx-virtualization \
    virtualization-layer \
    security \
    tpm-layer \
    qt6-layer \
    "

LAYERSERIES_COMPAT_amd-edf-core = "wrynose"

LAYERRECOMMENDS_amd-edf-core = "\
    kria-bsp \
    kria-core \
    xilinx-mali400 \
    xilinx-gpu-malig78ae \
    xilinx-multimedia \
    jupyter-layer \
    dpdk \
    amd-dpdk \
    "

LAYERBASE_amd-edf-core = "${LAYERDIR}"
AMD-EDF_OECORE = "${LAYERBASE_amd-edf-core}/oe-core"

# The official manifest does not include a Zenoh implementation layer. Keep the
# Fast DDS and Cyclone DDS implementations available without pulling Zenoh into
# rmw-implementation, and retain test fixtures that work with those providers.
ROS_WORLD_SKIP_GROUPS:append = " zenoh"
SKIP_RECIPE[rmw-test-fixture-implementation] = ""
SKIP_RECIPE[launch-testing-ros] = ""

BBFILES_DYNAMIC += " \
    xilinx-mali400:${LAYERDIR}/dynamic-layers/xilinx-mali400/recipes-*/*/*.bb \
    xilinx-mali400:${LAYERDIR}/dynamic-layers/xilinx-mali400/recipes-*/*/*.bbappend \
    xilinx-virtualization:${LAYERDIR}/dynamic-layers/xilinx-virtualization/recipes-*/*/*.bbappend \
    kria-bsp:${LAYERDIR}/dynamic-layers/kria/recipes-*/*/*.bb \
    kria-bsp:${LAYERDIR}/dynamic-layers/kria/recipes-*/*/*.bbappend \
    "

USER_CLASSES += "amd-edf-check-image"
```
