## conf/distro/amd-edf.conf
```bitbake
require conf/distro/poky-altcfg.conf

include conf/distro/include/amd-edf-feed.conf

include conf/distro/include/amd-edf-mirrors.conf

# Because we are no longer strictly poky-altcfg, set distro variables

DISTRO = "amd-edf"
DISTRO_NAME = "AMD Embedded Development Framework Linux distribution"

# Define the default hostname
hostname:pn-base-files:amd-edf = "amd-edf"

# Based on poky-altcfg
DISTROOVERRIDES = "poky:poky-altcfg:amd-edf"

AMD-EDF_VERSION = "26.06"
AMD-EDF_MINOR = ""

# Set to "development" or "release" for release
AMD-EDF_VER_TYPE = "release"

# This will be set in local.conf for CI builds
AMD-EDF_VER_BUILD ?= "${@'${METADATA_REVISION}' if d.getVar('METADATA_REVISION') != '<unknown>' else 'unknown'}"

# Follow the Poky format of <Version>+<type>-<date>
DISTRO_VERSION = "${AMD-EDF_VERSION}${AMD-EDF_MINOR}+${AMD-EDF_VER_TYPE}-${AMD-EDF_VER_BUILD}"

SDK_VENDOR = "-amdedfsdk"

MAINTAINER = "AMD AECG <meta-xilinx@yoctoproject.org>"

TARGET_VENDOR = "-amd"

# Define the ROS2 Yocto release
ROS_OE_RELEASE_SERIES = "scarthgap"

# Define ROS2 distro release
ROS_DISTRO = "jazzy"

# While microblaze (classic) is not supported, we want to ensure it can
# be built if needed
POKY_INIT_MANAGER:amd-edf:microblaze = "sysvinit"
AMD-EDF_DISTRO_FEATURES:amd-edf:microblaze = ""
AMD-EDF_DISTRO_FEATURES:amd-edf:microblaze-v = ""

AMD-EDF_DISTRO_FEATURES:amd-edf = " \
    multiarch \
    security \
    virtualization \
    "

AMD-EDF_DISTRO_FEATURES:amd-edf:append:arm = " \
    vmsep \
    "

AMD-EDF_DISTRO_FEATURES:amd-edf:append:aarch64 = " \
    openamp \
    tpm \
    vmsep \
    xen \
    efi \
    polkit \
    kvm \
    "

DISTRO_FEATURES:append = " ${AMD-EDF_DISTRO_FEATURES}"

# Set EFI_PROVIDER to systemd-boot for EDF by default
EFI_PROVIDER ?= "systemd-boot"

# Partition type GUIDs are defined in the the Discoverable Partition Specification
ROOTFS_PART_TYPE:arm = "69DAD710-2CE4-4E3C-B16C-21A1D49ABED3"
ROOTFS_PART_TYPE:aarch64 = "B921B045-1DF0-41C3-AF44-4C6F280D3FAE"
ROOTFS_PART_TYPE:riscv32 = "60D5A7FE-8E7D-435C-B714-3DD8162144E1"
ROOTFS_PART_TYPE:riscv64 = "72EC70A6-CF74-40E6-BD49-4BDA08E8F224"
ROOTFS_PART_TYPE:x86-64 = "4F68BCE3-E8CD-4DB1-96E7-FBCAF984B709"
ESP_PART_TYPE = "C12A7328-F81F-11D2-BA4B-00A0C93EC93B"
# GUID for "Linux generic" partition type (Discoverable Partitions Spec)
STORAGE_PART_TYPE = "0FC63DAF-8483-4772-8E79-3D69D8477DE4"

PREFERRED_RPROVIDER_virtual-systemd-bootconf = "systemd-bootconf-edf"

# The following really should not refer to MACHINE_FEATURES, but there isn't
# a better way at this point
DISTRO_FEATURES:append = "${@bb.utils.contains('MACHINE_FEATURES', 'mali400', ' libmali', '', d)}"
DISTRO_FEATURES:append = "${@bb.utils.contains('MACHINE_FEATURES', 'malig78ae', ' libmali', '', d)}"
DISTRO_FEATURES[vardepsexclude] += "MACHINE_FEATURES"

# Disable Busybox - Based on Poky example here:
# poky/meta-poky/conf/templates/default/local.conf.sample.extended

PREFERRED_PROVIDER_base-utils = "packagegroup-core-base-utils"
VIRTUAL-RUNTIME_base-utils = "packagegroup-core-base-utils"
VIRTUAL-RUNTIME_base-utils-hwclock = "util-linux-hwclock"
VIRTUAL-RUNTIME_base-utils-syslog = ""

# Enable license package generation
LICENSE_CREATE_PACKAGE = "1"

# Set start-jupyterlab as default start daemon.
PREFERRED_PROVIDER_start-jupyter = "start-jupyterlab"

# Set stress-ng as preferred stress tool.
PREFERRED_PROVIDER_stress = "stress-ng"
PREFERRED_RPROVIDER_stress = "stress-ng"

# Boot script only required for Zynq, ZynqMP and Kria devices.
# Boot script recipe for distro boot (used when efi not in MACHINE_FEATURES)
UBOOT_BOOT_SCRIPT:amd-edf = "u-boot-edf-scr"

# Support enable/disabling on a rootfs basis systemd services
IMAGE_CLASSES += "rootfs-config-systemd-services"

# If a serial console was not defined, we need to open a console on /dev/console
IMAGE_FEATURES += "${@'console-getty' if not d.getVar('SERIAL_CONSOLES') else ''}"

# Configure default users/groups
# Default rules (assumed no debug-tweaks image feature):
# * disabled root login (set by system default)
# * Add a user 'amd-edf' with no password
#   - SSH won't allow passwd-less login w/o debug tweaks, so requires console login
#   - Set to immediately expire
#   - Add to the sudoers file
# * Add 'amd-edf' user to the audio, video, and users groups
IMAGE_CLASSES += "extrausers"
EXTRA_USERS_PARAMS ?= "\
    useradd -p '' amd-edf;passwd-expire amd-edf; \
    groupadd -r aie; \
    groupadd -r wayland; \
    usermod -a -G aie,audio,input,users,video,wayland amd-edf; \
"
USERADDEXTENSION:append = " amd-useradd-sudoers"
EXTRA_USERS_SUDOERS ?= "amd-edf ALL=(ALL) ALL;"

# Disable OpenAMP device tree overlay package
ENABLE_OPENAMP_DTSI = "${@bb.utils.contains('DISTRO_FEATURES', 'openamp', '2', '0', d)}"

# Use iwd instead of the default wpa-supplicant. iwd is a more modern
# wireless daemon; wpa-supplicant is considered legacy.
WIRELESS_DAEMON = "iwd"
```

## conf/layer.conf
```bitbake
# We have a conf and classes directory, add to BBPATH
BBPATH .= ":${LAYERDIR}"

# TO override a oe-core bbclass
BBPATH =. "${LAYERDIR}/oe-core/meta:"

# We have recipes-* directories, add to BBFILES
BBFILES += " \
    ${LAYERDIR}/recipes-*/*/*.bb \
    ${LAYERDIR}/recipes-*/*/*.bbappend \
    "

BBFILE_COLLECTIONS += "amd-edf"
BBFILE_PRIORITY_amd-edf = "5"

LAYERSUMMARY_amd-edf = "AMD Embedded Development Framework reference \
distro"
LAYERDESCRIPTION_amd-edf = "Distribution layer providing the amd-edf \
and amd-edf-small distros, image recipes, packagegroups, and SDK \
helpers that make up the AMD Embedded Development Framework reference \
platform."
BBFILE_PATTERN_amd-edf = "^${LAYERDIR}/"
BBFILE_PATTERN_IGNORE_EMPTY_amd-edf = "1"

LAYERDEPENDS_amd-edf = "\
    core \
    xilinx \
    xilinx-standalone \
    xilinx-standalone-sdt \
    xilinx-microblaze \
    xilinx-demos \
    meta-xilinx-imgrcry \
    amd-adaptive-socs-core \
    amd-adaptive-socs-bsp \
    ros2-layer \
    ros2-jazzy-layer \
    openamp-layer \
    xilinx-virtualization \
    virtualization-layer \
    security \
    tpm-layer \
    qt5-layer \
    "

LAYERSERIES_COMPAT_amd-edf = "scarthgap"

LAYERRECOMMENDS_amd-edf = "kria"

LAYERBASE_amd-edf = "${LAYERDIR}"
AMD-EDF_OECORE = "${LAYERBASE_amd-edf}/oe-core"

BBFILES_DYNAMIC += " \
    xilinx-mali400:${LAYERDIR}/dynamic-layers/xilinx-mali400/recipes-*/*/*.bb \
    xilinx-mali400:${LAYERDIR}/dynamic-layers/xilinx-mali400/recipes-*/*/*.bbappend \
    xilinx-virtualization:${LAYERDIR}/dynamic-layers/xilinx-virtualization/recipes-*/*/*.bbappend \
    kria:${LAYERDIR}/dynamic-layers/kria/recipes-*/*/*.bb \
    kria:${LAYERDIR}/dynamic-layers/kria/recipes-*/*/*.bbappend \
    "

USER_CLASSES += "amd-edf-check-image"
```

## meta-amd-edf-bsp/conf/layer.conf
```bitbake
# We have a conf and classes directory, add to BBPATH
BBPATH .= ":${LAYERDIR}"

# We have recipes-* directories, add to BBFILES
BBFILES += " \
    ${LAYERDIR}/recipes-*/*/*.bb \
    ${LAYERDIR}/recipes-*/*/*.bbappend \
    "

BBFILE_COLLECTIONS += "amd-edf-bsp"
BBFILE_PRIORITY_amd-edf-bsp = "5"

LAYERSUMMARY_amd-edf-bsp = "AMD Embedded Development Framework BSP \
common machines"
LAYERDESCRIPTION_amd-edf-bsp = "BSP layer for the AMD Embedded \
Development Framework reference distro: shared common-machine .conf \
files (per Cortex-Ax / RISC-V tune) used to build root filesystems \
across multiple AMD boards."
BBFILE_PATTERN_amd-edf-bsp = "^${LAYERDIR}/"
BBFILE_PATTERN_IGNORE_EMPTY_amd-edf-bsp = "1"

LAYERDEPENDS_amd-edf-bsp = "\
    amd-edf \
    "

LAYERSERIES_COMPAT_amd-edf-bsp = "scarthgap"
```

## meta-amd-edf-bsp/conf/machine/amd-cortexa53-common.conf
```bitbake
#@TYPE: Machine
#@NAME: amd-cortexa53-common
#@DESCRIPTION: Common AMD machine used to build a shared root filesystem for Cortex-A53 boards without a Mali-400 GPU (e.g. Zynq UltraScale+ MPSoC CG/DR variants). Not bootable on its own.

#### Preamble
MACHINEOVERRIDES =. "${@['', 'amd-cortexa53-common:']['amd-cortexa53-common' != '${MACHINE}']}"
#### Regular settings follow

DEFAULTTUNE = "cortexa72-cortexa53"

# These devices are all zynqmp related
require conf/machine/zynqmp-generic.conf

# We do not want the boot.bin, bootloader and other pre-Linux things to build,
# these should come from the machine
HW_BOOT_MODE = ""
SOC_ON_DISK_BOOT_BIN = ""
EXTRA_IMAGEDEPENDS = "qemu-devicetrees-native"
IMAGE_BOOT_FILES = ""
IMAGE_EFI_BOOT_FILES = ""

# Clear serial consoles, use the kernel console=
SERIAL_CONSOLES = ""

# Clear the machine specifc settings
QB_CMDLINE_IP_SLIRP = ""
QB_CMDLINE_IP_TAP = ""
QB_DEFAULT_KERNEL = ""
QB_DTB = ""
QB_MACHINE = ""
QB_MEM = ""
QB_NETWORK_DEVICE = ""
QB_NO_PNI = ""
QB_OPT_APPEND = ""
QB_ROOTFS_OPT = ""
QB_SERIAL_OPT = ""

MACHINE_FEATURES += "rfsoc fpga-overlay efi usbgadget wifi"

ENABLE_TSN = "1"
#### No additional settings should be after the Postamble
#### Postamble
PACKAGE_EXTRA_ARCHS:append = "${@['', ' amd_cortexa53_common']['amd-cortexa53-common' != "${MACHINE}"]}"
```

## meta-amd-edf-bsp/conf/machine/amd-cortexa78-common.conf
```bitbake
#@TYPE: Machine
#@NAME: amd-cortexa78-common
#@DESCRIPTION: Common AMD machine used to build a shared Cortex-A78 root filesystem for Versal NET / Versal Series Gen 2 boards without a Mali-G78AE GPU. Not bootable on its own.

#### Preamble
MACHINEOVERRIDES =. "${@['', 'amd-cortexa78-common:']['amd-cortexa78-common' != '${MACHINE}']}"
#### Regular settings follow

DEFAULTTUNE = "cortexa72-cortexa53"

# Currently these devices are primarily versal-net based
require conf/machine/versal-net-generic.conf

# We do not want the boot.bin, bootloader and other pre-Linux things to build,
# these should come from the machine
HW_BOOT_MODE = ""
SOC_ON_DISK_BOOT_BIN = ""
EXTRA_IMAGEDEPENDS = "qemu-devicetrees-native"
IMAGE_BOOT_FILES = ""
IMAGE_EFI_BOOT_FILES = ""

# Clear serial consoles, use the kernel console=
SERIAL_CONSOLES = ""

# Clear the machine specifc settings
QB_CMDLINE_IP_SLIRP = ""
QB_CMDLINE_IP_TAP = ""
QB_DEFAULT_KERNEL = ""
QB_DTB = ""
QB_MACHINE = ""
QB_MEM = ""
QB_NETWORK_DEVICE = ""
QB_NO_PNI = ""
QB_OPT_APPEND = ""
QB_ROOTFS_OPT = ""
QB_SERIAL_OPT = ""

MACHINE_FEATURES += "fpga-overlay efi usbgadget wifi"

ENABLE_TSN = "1"
#### No additional settings should be after the Postamble
#### Postamble
PACKAGE_EXTRA_ARCHS:append = "${@['', ' amd_cortexa78_common']['amd-cortexa78-common' != "${MACHINE}"]}"
```

## meta-amd-edf-bsp/conf/machine/amd-cortexa9thf-neon-common.conf
```bitbake
#@TYPE: Machine
#@NAME: amd-cortexa9thf-neon-common
#@DESCRIPTION: Common AMD machine used to build a shared Cortex-A9 root filesystem (Thumb-2, hardfloat, NEON) for Zynq-7000 boards. Not bootable on its own.

#### Preamble
MACHINEOVERRIDES =. "${@['', 'amd-cortexa9thf-neon-common:']['amd-cortexa9thf-neon-common' != '${MACHINE}']}"
#### Regular settings follow

DEFAULTTUNE = "cortexa9thf-neon"

# These devices are all Zynq based
require conf/machine/zynq-generic.conf

# We do not want the boot.bin, bootloader and other pre-Linux things to build,
# these should come from the machine
HW_BOOT_MODE = ""
SOC_ON_DISK_BOOT_BIN = ""
EXTRA_IMAGEDEPENDS = "qemu-devicetrees-native"
IMAGE_EFI_BOOT_FILES = ""

# We do want to deploy the boot.scr
IMAGE_BOOT_FILES = "boot.scr"

# Clear serial consoles, use the kernel console=
SERIAL_CONSOLES = ""

# Clear the machine specifc settings
QB_CMDLINE_IP_SLIRP = ""
QB_CMDLINE_IP_TAP = ""
QB_DEFAULT_KERNEL = ""
QB_DTB = ""
QB_MACHINE = ""
QB_MEM = ""
QB_NETWORK_DEVICE = ""
QB_NO_PNI = ""
QB_OPT_APPEND = ""
QB_ROOTFS_OPT = ""
QB_SERIAL_OPT = ""

MACHINE_FEATURES += "fpga-overlay wifi"

#### No additional settings should be after the Postamble
#### Postamble
PACKAGE_EXTRA_ARCHS:append = "${@['', ' amd_cortexa9thf_neon_common']['amd-cortexa9thf-neon-common' != "${MACHINE}"]}"
```

## meta-amd-edf-core/conf/distro/amd-edf-small.conf
```bitbake
require conf/distro/amd-edf.conf

DISTRO = "amd-edf-small"
DISTRO_NAME = "AMD Embedded Development Framework (Small) Linux distribution"

# Based on poky
DISTROOVERRIDES = "poky:amd-edf:amd-edf-small"

# Default to sysvinit
POKY_INIT_MANAGER:amd-edf-small = "sysvinit"

POKY_DEFAULT_DISTRO_FEATURES:amd-edf-small = ""

#Small does not support mulitarch, security or virtualization like amd-edf does.
AMD-EDF_DISTRO_FEATURES:amd-edf-small = ""

AMD-EDF_DISTRO_FEATURES:amd-edf-small:append:aarch64 = " \
    openamp \
    efi \
    "

# Stop packagegroup-core-boot from including bootbin, device-tree and kernel to /boot
MACHINE_ESSENTIAL_EXTRA_RDEPENDS:pn-packagegroup-core-boot = ""

# Instead include that software into a standard rootfs
ROOTFS_BOOTSTRAP_INSTALL:append = " ${MACHINE_ESSENTIAL_EXTRA_RDEPENDS}"

# For a smaller system, we want smaller kernels
# Switch the KERNEL_IMAGETYPE to compressed
DEFAULT_KERNEL_IMAGETYPE := "${KERNEL_IMAGETYPE}"
DEFAULT_KERNEL_IMAGETYPE:arm = "uImage"
DEFAULT_KERNEL_IMAGETYPE:aarch64 = "Image.lzma"

KERNEL_IMAGETYPES += "${DEFAULT_KERNEL_IMAGETYPE}"
KERNEL_IMAGETYPE = "${DEFAULT_KERNEL_IMAGETYPE}"

# Switch to small kernel
PREFERRED_PROVIDER_virtual/kernel:zynqmp = "linux-xlnx-small"
PREFERRED_PROVIDER_virtual/kernel:versal = "linux-xlnx-small"
PREFERRED_PROVIDER_virtual/kernel:versal-net = "linux-xlnx-small"
PREFERRED_PROVIDER_virtual/kernel:versal-2ve-2vm = "linux-xlnx-small"

# Enable busybox
PREFERRED_PROVIDER_base-utils = "busybox"
VIRTUAL-RUNTIME_base-utils = "busybox"
VIRTUAL-RUNTIME_base-utils-hwclock = "busybox-hwclock"
VIRTUAL-RUNTIME_base-utils-syslog = "busybox-syslog"
```

## meta-amd-edf-core/files/wic/edf-disk-single-rootfs-efi.wks
```
# Partitioned disk image for AMD Embedded Development Framework - EFI booted
#
# layout:
#     /efi         1GB      - used for boot.bin and Arm SystemReady-compatible EFI firmware update capsules
#     /storage     2GB      - user storage
#     /                     - general-purpose, Yocto-built Linux user-space filesystem (no fixed size, systemd will grow the partition and file system during boot based on disk size)

part  /efi       --source bootimg-efi-amd --sourceparams="loader=${EFI_PROVIDER},rootfs_uuid=${ROOTFS_PART_UUID}" --fixed-size=1G  --align 16 --fstype=vfat  --use-label  --label esp  --active  --mbr  --use-uuid  --part-type="${ESP_PART_TYPE}"  --part-name="ESP"
part  /storage                            --fixed-size=2G    --align 4  --fstype=vfat  --use-label  --label storage  --mbr  --part-type="${STORAGE_PART_TYPE}"  --part-name="storage"  --fsoptions="defaults,gid=100,umask=0002"
part  /          --source rootfs          --align 4  --fstype=ext4  --use-label  --label root --uuid="${ROOTFS_PART_UUID}"  --use-uuid --part-type="${ROOTFS_PART_TYPE}"

bootloader --ptable gpt-hybrid
```

## wic/edf-disk-single-rootfs.wks
```
# Partitioned disk image for AMD Embedded Development Framework
#
# layout:
#     /efi        1GB      - empty vfat partition (see note below)
#     /storage    2GB      - user storage
#     /                    - general-purpose, Yocto-built Linux user-space filesystem (no fixed size, systemd will grow the partition and file system during boot based on disk size)
#
# Note: The /efi partition mirrors the EFI layout for consistent partition numbering.
# It is not used for EFI boot, but can hold BOOT.bin for SD card boot on platforms
# that load firmware from the first vfat partition.

part  /efi       --source bootimg-partition  --fixed-size=1G  --align 4  --fstype=vfat  --use-label  --label esp  --active
part  /storage   --fixed-size=2G  --align 4  --fstype=vfat  --use-label  --label storage  --fsoptions="defaults,gid=100,umask=0002"
part  /          --source rootfs  --align 4  --fstype=ext4  --use-label  --label root

bootloader --ptable msdos
```
